## conf/machine/at91cap9adk.conf
```bitbake
#@TYPE: Machine
#@Name: Atmel AT91CAP9ADK Development Platform
#@DESCRIPTION: Machine configuration for the at91cap9adk development board with a at91cap9500 processor

include conf/machine/include/at91-2.6.38.inc
include conf/machine/include/at91-lcd.inc

# Has linux config file in OpenEmbedded
# 
# LINUX26_DEFCONFIG = "at91cap9adk_defconfig"


# Supported u-boot machines
UBOOT_MACHINE = "at91cap9adk_config"
UBOOT_MACHINES = " at91cap9adk "

AT91BOOTSTRAP_BOARD = " at91cap9adk "

MACHINE_FEATURES += " usbhost "
```

## conf/machine/at91cap9stk.conf
```bitbake
#@TYPE: Machine
#@Name: Atmel AT91CAP9STK Development Platform
#@DESCRIPTION: Machine configuration for the at91cap9stk board with a at91cap9 processor

include conf/machine/include/at91-2.6.38.inc
include conf/machine/include/at91-lcd.inc

# Has linux config file in OpenEmbedded
#
# LINUX26_DEFCONFIG = "at91cap9stk_defconfig"


# Supported u-boot machines
UBOOT_MACHINE = "at91cap9adk_config"

UBOOT_MACHINES = " at91cap9adk "

AT91BOOTSTRAP_BOARD = " at91cap9stk at91cap9stkdf at91cap9stkf "

MACHINE_FEATURES += " usbhost "
```

## conf/machine/at91sam9260ek.conf
```bitbake
#@TYPE: Machine
#@Name: Atmel AT91SAM9260EK Development Platform
#@DESCRIPTION: Machine configuration for the at91sam9260ek development board with a at91sam9260 processor

include conf/machine/include/at91-2.6.38.inc


# Has linux config file in OpenEmbedded
# 
# LINUX26_DEFCONFIG = "at91sam9260ek_defconfig"


# Supported u-boot machines
UBOOT_MACHINE = "at91sam9260ek_dataflash_cs1_config"

UBOOT_MACHINES = " at91sam9260ek_nandflash at91sam9260ek_dataflash_cs0 at91sam9260ek_dataflash_cs1 at91sam9260ek "

AT91BOOTSTRAP_BOARD = " at91sam9260ek at91sam9260df at91sam9260dfc at91sam9260nf "

MACHINE_FEATURES += " usbhost "
```

## conf/machine/at91sam9261ek.conf
```bitbake
#@TYPE: Machine
#@Name: Atmel AT91SAM9261EK Development Platform
#@DESCRIPTION: Machine configuration for the at91sam9261ek development board with a at91sam9261 processor

include conf/machine/include/at91-2.6.38.inc
include conf/machine/include/at91-lcd.inc

# Has linux config file in OpenEmbedded
# 
# LINUX26_DEFCONFIG = "at91sam9261ek_defconfig"


# Supported u-boot machines
UBOOT_MACHINE = "at91sam9261ek_config"

UBOOT_MACHINES = " at91sam9261ek_nandflash at91sam9261ek_dataflash_cs0 at91sam9261ek_dataflash_cs3  at91sam9261ek_config "

AT91BOOTSTRAP_BOARD = " at91sam9261df at91sam9261dfc at91sam9261ek at91sam9261nf "

MACHINE_FEATURES += " usbhost "
```

## conf/machine/at91sam9263ek.conf
```bitbake
#@TYPE: Machine
#@Name: Atmel AT91SAM9263EK Development Platform
#@DESCRIPTION: Machine configuration for the at91sam9263ek development board with a at91sam9263 processor

include conf/machine/include/at91-2.6.38.inc
include conf/machine/include/at91-lcd.inc

# Has linux config file in OpenEmbedded
# 
# LINUX26_DEFCONFIG = "at91sam9263ek_defconfig"


# Supported u-boot machines
UBOOT_MACHINE = "at91sam9263ek_config"

UBOOT_MACHINES = " \
	at91sam9263ek_norflash_config \
	at91sam9263ek_norflash_boot_config \
	at91sam9263ek_nandflash \
	at91sam9263ek_dataflash at91sam9263ek_dataflash_cs0 \
	at91sam9263ek_config "

AT91BOOTSTRAP_BOARD = " at91sam9263df at91sam9263dfc at91sam9263ek at91sam9263nf "

MACHINE_FEATURES += " usbhost "
```

## conf/machine/at91sam9g10ek.conf
```bitbake
#@TYPE: Machine
#@Name: Atmel AT91SAM9G10EK Development Platform
#@DESCRIPTION: Machine configuration for the at91sam9g10ek development board with a at91sam9g10 processor

include conf/machine/include/at91-2.6.38.inc
include conf/machine/include/at91-lcd.inc

# Has linux config file in OpenEmbedded
# 
# LINUX26_DEFCONFIG = "at91sam9g20ek_defconfig"


# Supported u-boot machines
UBOOT_MACHINE = "at91sam9g10ek_dataflash_cs0_config"

UBOOT_MACHINES = " at91sam9g10ek_nandflash at91sam9g10ek_dataflash_cs0 at91sam9g10ek_dataflash_cs3 at91sam9g10ek "

AT91BOOTSTRAP_BOARD = " at91sam9g10ek at91sam9g10df at91sam9g10nf "

MACHINE_FEATURES += " usbhost "
```

## conf/machine/at91sam9g20ek.conf
```bitbake
#@TYPE: Machine
#@Name: Atmel AT91SAM9G20EK Development Platform
#@DESCRIPTION: Machine configuration for the at91sam9g20ek development board with a at91sam9g20 processor

include conf/machine/include/at91-2.6.38.inc

# Has linux config file in OpenEmbedded
# 
# LINUX26_DEFCONFIG = "at91sam9g20ek_defconfig"


# Supported u-boot machines
UBOOT_MACHINE = "at91sam9g20ek_dataflash_cs1_config"

UBOOT_MACHINES = " at91sam9g20ek_nandflash at91sam9g20ek_dataflash_cs0 at91sam9g20ek_dataflash_cs1  at91sam9g20ek_config "

AT91BOOTSTRAP_BOARD = " at91sam9g20ek at91sam9g20df at91sam9g20nf "

MACHINE_FEATURES += " usbhost "
```

## conf/machine/at91sam9g45ekes.conf
```bitbake
#@TYPE: Machine
#@Name: Atmel AT91SAM9G45EKES Development Platform
#@DESCRIPTION: Machine configuration for the at91sam9g45ekes development board with a at91sam9g45-es processor

include conf/machine/include/at91-2.6.38.inc
include conf/machine/include/at91-lcd.inc

# Has linux config file in OpenEmbedded
#
# LINUX26_DEFCONFIG = "at91sam9g45ek_defconfig"
# LINUX26_DEFCONFIG = "at91sam9m10g45ek_defconfig"

# Supported u-boot machines
UBOOT_MACHINE = "at91sam9m10g45ek_dataflash_cs0_config"

UBOOT_MACHINES = " \
	at91sam9g45ekes_nandflash \
	at91sam9g45ekes_dataflash \
	at91sam9g45ekes_dataflash_cs0 \
	at91sam9g45ekes_sd \
	at91sam9g45ekes \
	at91sam9m10g45ek_dataflash_cs0 "

AT91BOOTSTRAP_BOARD = " at91sam9g45df at91sam9g45ek at91sam9g45nf "

MACHINE_FEATURES += " usbhost "
```

## conf/machine/at91sam9m10g45ek.conf
```bitbake
#@TYPE: Machine
#@Name: Atmel AT91SAM9M10G45EK Development Platform
#@DESCRIPTION: Machine configuration for the at91sam9m10g45ek board with a at91sam9m10 processor

include conf/machine/include/at91-2.6.38.inc
include conf/machine/include/at91-lcd.inc

# Has linux config file in OpenEmbedded
# 
# LINUX26_DEFCONFIG = "at91sam9m10ekes_defconfig"
# LINUX26_DEFCONFIG = "at91sam9m10g45ek_defconfig"

# Supported u-boot machines
UBOOT_MACHINE = "at91sam9m10g45ek_dataflash_cs0_config"

UBOOT_MACHINES = " at91sam9m10g45ek_nandflash at91sam9m10g45ek_dataflash at91sam9m10g45ek_dataflash_cs0 at91sam9m10g45ek at91sam9m10g45ek_sd_config "

AT91BOOTSTRAP_BOARD = " at91sam9g45df at91sam9g45ek at91sam9g45nf "

MACHINE_FEATURES += " usbhost "
```

## conf/machine/at91sam9rlek.conf
```bitbake
#@TYPE: Machine
#@Name: Atmel AT91SAM9RLEK Development Platform
#@DESCRIPTION: Machine configuration for the at91sam9rlek development board with a at91sam9rl64 processor

include conf/machine/include/at91-2.6.38.inc
include conf/machine/include/at91-lcd.inc

# Has linux config file in OpenEmbedded
# 
# LINUX26_DEFCONFIG = "at91sam9rlek_defconfig"


# Supported u-boot machines
UBOOT_MACHINE = "at91sam9rlek_config"

UBOOT_MACHINES = " at91sam9rlek_nandflash at91sam9rlek_dataflash at91sam9rlek_dataflash_cs0 at91sam9rlek "

AT91BOOTSTRAP_BOARD = " at91sam9rldf at91sam9rlek at91sam9rlnf at91sam9rlsd "
```
